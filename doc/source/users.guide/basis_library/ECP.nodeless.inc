The ECP libraries have also been extended to include the so-called nodeless ECPs or pseudo potentials
based on the Phillips-Kleinman equation :cite:`Phillips:59`.
These are included both as explicit and implicit operators.
Following the work by M. Pelissier and co-workers :cite:`Pelissier:1988`
the operators of nodeless ECPs can implicitly be fully expressed via spectral representation of operators.
The explicit libraries are the ECP.STOLL and ECP.HAY-WADT files, all other files are for the
implicitly expressed operator.
In the list of nodeless ECPs the Hay and Wadt's family of ECPs
(LANL2DZ ECPs) :cite:`Hay:1985a,Hay:1985b,Hay:1985c` has been
included in addition to the popular set of the so-called Stoll and Dolg
ECPs :cite:`ECP:1,ECP:2,ECP:3,ECP:4,ECP:5,ECP:6,ECP:7,ECP:8,ECP:9,ECP:10,ECP:11,ECP:12,ECP:13,ECP:14,ECP:15,ECP:16,ECP:17,ECP:18,ECP:19,ECP:20,ECP:21,ECP:22,ECP:23,ECP:24,ECP:25`.
Both of them in either the explicit form labeled as HAY-WADT and STOLL, or in the implicit form
labeled as HW and DOLG.
The latter include the recently developed ANO-basis sets for actinides :cite:`ECP:25`.


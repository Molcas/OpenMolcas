/***********************************************************************
* This file is part of OpenMolcas.                                     *
*                                                                      *
* OpenMolcas is free software; you can redistribute it and/or modify   *
* it under the terms of the GNU Lesser General Public License, v. 2.1. *
* OpenMolcas is distributed in the hope that it will be useful, but it *
* is provided "as is" and without any express or implied warranties.   *
* For more details see the full text of the license in the file        *
* LICENSE or in <http://www.gnu.org/licenses/>.                        *
***********************************************************************/
#include "aoints.inc"
#include "choints.inc"
#include "orbitals.inc"
#include "wfnfiles.inc"
#include "moldenfiles.inc"
 (file)  JOBIPH   "$WorkDir/$Project."JobIph      ro
 (file)  JOBIPH01 "$WorkDir/$Project."JobIph01    ro
 (file)  JOBIPH02 "$WorkDir/$Project."JobIph02    ro
 (file)  JOBIPH03 "$WorkDir/$Project."JobIph03    ro
 (file)  JOBIPH04 "$WorkDir/$Project."JobIph04    ro
 (file)  JOBIPH05 "$WorkDir/$Project."JobIph05    ro
 (file)  JOBIPH06 "$WorkDir/$Project."JobIph06    ro
 (file)  JOBIPH07 "$WorkDir/$Project."JobIph07    ro
 (file)  JOBIPH08 "$WorkDir/$Project."JobIph08    ro
 (file)  JOBIPH09 "$WorkDir/$Project."JobIph09    ro
 (file)  JOBIPH10 "$WorkDir/$Project."JobIph10    ro
 (file)  JOBMIX   "$WorkDir/$Project."JobMix      ro
 (file)  SCRATCH  "$WorkDir/"purge.tmp001         rw
 (file)  TDMFILE  "$WorkDir/"purge.tmp002         rw
 (file)  ANNI     "$WorkDir/"purge.tmp003         rw
 (file)  EXTRACT  "$WorkDir/$Project."Extract     rw
 (file)  TOFILE   "$WorkDir/$Project."ToFile      rw
 (file)  EIGV     "$WorkDir/$Project."EigV        rw

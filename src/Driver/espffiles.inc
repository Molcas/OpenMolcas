/***********************************************************************
* This file is part of OpenMolcas.                                     *
*                                                                      *
* OpenMolcas is free software; you can redistribute it and/or modify   *
* it under the terms of the GNU Lesser General Public License, v. 2.1. *
* OpenMolcas is distributed in the hope that it will be useful, but it *
* is provided "as is" and without any express or implied warranties.   *
* For more details see the full text of the license in the file        *
* LICENSE or in <http://www.gnu.org/licenses/>.                        *
***********************************************************************/
#ifndef _ESPFFILES_
 (file)  ESPF.DATA     "$WorkDir/$Project."Espf.Data        rw
 (file)  ESPF.EXTPOT   "$WorkDir/$Project."Espf.ExtPot      rw
 (file)  QMMM          "$WorkDir/$Project."qmmm             rw
 (file)  TINKER.XYZ    "$WorkDir/$Project."xyz              rw
 (file)  TINKER.KEY    "$WorkDir/$Project."key              rw
 (file)  TINKER.LOG    "$WorkDir/$Project."Tinker.log       rw
 (file)  GMX.XYZ       "$WorkDir/$Project."gmx.xyz          rw
 (file)  GMX.LOG       "$WorkDir/$Project."gmx.log          rw
#define _ESPFFILES_
#endif

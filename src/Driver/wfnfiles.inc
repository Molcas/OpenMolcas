/***********************************************************************
* This file is part of OpenMolcas.                                     *
*                                                                      *
* OpenMolcas is free software; you can redistribute it and/or modify   *
* it under the terms of the GNU Lesser General Public License, v. 2.1. *
* OpenMolcas is distributed in the hope that it will be useful, but it *
* is provided "as is" and without any express or implied warranties.   *
* For more details see the full text of the license in the file        *
* LICENSE or in <http://www.gnu.org/licenses/>.                        *
***********************************************************************/
#ifndef _WFNFILES_
 (file)  GSSWFN   "$WorkDir/$Project$SubProject."guessorb.h5 rws
 (file)  POLYWFN  "$WorkDir/$Project$SubProject."poly.h5     rws
 (file)  RASWFN   "$WorkDir/$Project$SubProject."rasscf.h5   rws
 (file)  PT2WFN   "$WorkDir/$Project$SubProject."caspt2.h5   rws
 (file)  RASSIWFN "$WorkDir/$Project$SubProject."rassi.h5    rws
 (file)  SCFWFN   "$WorkDir/$Project$SubProject."scf.h5      rws
#define _WFNFILES_
#endif

/***********************************************************************
* This file is part of OpenMolcas.                                     *
*                                                                      *
* OpenMolcas is free software; you can redistribute it and/or modify   *
* it under the terms of the GNU Lesser General Public License, v. 2.1. *
* OpenMolcas is distributed in the hope that it will be useful, but it *
* is provided "as is" and without any express or implied warranties.   *
* For more details see the full text of the license in the file        *
* LICENSE or in <http://www.gnu.org/licenses/>.                        *
***********************************************************************/
#ifndef _GEOCOMMON_
 (file) disp.xyz      "$GeoDir/$Project.disp.xyz"    rw.
 (file) hyp.zmt       "$GeoDir/$Project.zmt"         rw
 (file) hyp.con       "$GeoDir/$Project.connect"     rw
 (file) gwcopy        "$GeoDir/$Project.gwcopy.input" rw
 (file) disp.info     "$GeoDir/disp.info"            rw.
 (file) general.info  "$GeoDir/general.info"         rw
 (file) optim.info    "$GeoDir/optim.info"          rw
 (file) std.xyz       "$GeoDir/std.xyz"     rw
 (file) zmat.xyz      "$GeoDir/zmat.xyz"     rw
#define _GEOCOMMON_
#endif

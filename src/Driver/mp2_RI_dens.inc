/***********************************************************************
* This file is part of OpenMolcas.                                     *
*                                                                      *
* OpenMolcas is free software; you can redistribute it and/or modify   *
* it under the terms of the GNU Lesser General Public License, v. 2.1. *
* OpenMolcas is distributed in the hope that it will be useful, but it *
* is provided "as is" and without any express or implied warranties.   *
* For more details see the full text of the license in the file        *
* LICENSE or in <http://www.gnu.org/licenses/>.                        *
***********************************************************************/
#ifndef _MP2_RI_
 (file)  AMP2V         "$WorkDir/$Project."AMP2V           rw*
 (file)  BMP2V         "$WorkDir/$Project."BMP2V           rw*
 (file)  _AI           "$WorkDir/$Project."_AI             rw*
 (file)  _CD           "$WorkDir/$Project."_CD             rw*
 (file)  _I1__          "$WorkDir/$Project."_I1__             rw*
 (file)  _I2__          "$WorkDir/$Project."_I2__             rw*
 (file)  _I3__          "$WorkDir/$Project."_I3__             rw*
 (file)  _I4__          "$WorkDir/$Project."_I4__             rw*
 (file)  _I5__          "$WorkDir/$Project."_I5__             rw*
 (file)  _I6__          "$WorkDir/$Project."_I6__             rw*
 (file)  _I7__          "$WorkDir/$Project."_I7__             rw*
 (file)  _I8__          "$WorkDir/$Project."_I8__             rw*
 (file)  _I1_           "$WorkDir/$Project."_I1_              rw*
 (file)  _I2_           "$WorkDir/$Project."_I2_              rw*
 (file)  _I3_           "$WorkDir/$Project."_I3_              rw*
 (file)  _I4_           "$WorkDir/$Project."_I4_              rw*
 (file)  _I5_           "$WorkDir/$Project."_I5_              rw*
 (file)  _I6_           "$WorkDir/$Project."_I6_              rw*
 (file)  _I7_           "$WorkDir/$Project."_I7_              rw*
 (file)  _I8_           "$WorkDir/$Project."_I8_              rw*
 (file)  _I1            "$WorkDir/$Project."_I1               rw*
 (file)  _I2            "$WorkDir/$Project."_I2               rw*
 (file)  _I3            "$WorkDir/$Project."_I3               rw*
 (file)  _I4            "$WorkDir/$Project."_I4               rw*
 (file)  _I5            "$WorkDir/$Project."_I5               rw*
 (file)  _I6            "$WorkDir/$Project."_I6               rw*
 (file)  _I7            "$WorkDir/$Project."_I7               rw*
 (file)  _I8            "$WorkDir/$Project."_I8               rw*
#define _MP2_RI_
#endif

/***********************************************************************
* This file is part of OpenMolcas.                                     *
*                                                                      *
* OpenMolcas is free software; you can redistribute it and/or modify   *
* it under the terms of the GNU Lesser General Public License, v. 2.1. *
* OpenMolcas is distributed in the hope that it will be useful, but it *
* is provided "as is" and without any express or implied warranties.   *
* For more details see the full text of the license in the file        *
* LICENSE or in <http://www.gnu.org/licenses/>.                        *
***********************************************************************/
#ifndef _MOLDENFILES_
 (file)  MD_GSS    "$WorkDir/$Project$SubProject."guessorb.molden rwstg
 (file)  MD_LPR    "$WorkDir/$Project$SubProject."LoProp.molden   rwstg*
 (file)  MD_LOC    "$WorkDir/$Project$SubProject."local.molden    rwstg*
 (file)  MD_MP2    "$WorkDir/$Project$SubProject."mp2.molden      rwstg*
 (file)  MD_SCF    "$WorkDir/$Project$SubProject."scf.molden      rwstg*
 (file)  MD_CAS    "$WorkDir/$Project$SubProject."rasscf.molden   rwstg*
 (file)  MD_DYS    "$WorkDir/$Project$SubProject."dys.molden      rwstg*
 (file)  MD_PT2    "$WorkDir/$Project$SubProject."caspt2.molden   rwstg*
 (file)  MD_VB     "$WorkDir/$Project$SubProject."casvb.molden    rwstg*
 (file)  MD_GEO    "$WorkDir/$Project$SubProject."geo.molden      rwstg
 (file)  MD_MEP    "$WorkDir/$Project."mep.molden                 rwstg
 (file)  MD_SADDLE "$WorkDir/$Project."saddle.molden              rwstg
 (file)  MD_IRC    "$WorkDir/$Project."irc.molden                 rwstg
 (file)  MD_FREQ   "$WorkDir/$Project$SubProject."freq.molden     rwstg
#define _MOLDENFILES_
#endif

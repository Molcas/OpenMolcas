/***********************************************************************
* This file is part of OpenMolcas.                                     *
*                                                                      *
* OpenMolcas is free software; you can redistribute it and/or modify   *
* it under the terms of the GNU Lesser General Public License, v. 2.1. *
* OpenMolcas is distributed in the hope that it will be useful, but it *
* is provided "as is" and without any express or implied warranties.   *
* For more details see the full text of the license in the file        *
* LICENSE or in <http://www.gnu.org/licenses/>.                        *
***********************************************************************/
#ifndef _CHEMPS2FILES_
 (file) CHEMLOGT   "$WorkDir/"chemps2.log.total         rwst
 (file) CHEMNATFIE "$WorkDir/"molcas_natorb_fiedler.txt rwst
 (file) CHEMCANFIE "$WorkDir/"molcas_canorb_fiedler.txt rwst
 (file) CHEMFIE     "$WorkDir/"molcas_fiedler.txt       rwpt
 (file) CHEMNATMPS0 "$WorkDir/"CheMPS2_natorb_MPS0.h5   rws
 (file) CHEMCANMPS0 "$WorkDir/"CheMPS2_canorb_MPS0.h5   rws
#define _CHEMPS2FILES_
#endif

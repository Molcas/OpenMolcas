/***********************************************************************
* This file is part of OpenMolcas.                                     *
*                                                                      *
* OpenMolcas is free software; you can redistribute it and/or modify   *
* it under the terms of the GNU Lesser General Public License, v. 2.1. *
* OpenMolcas is distributed in the hope that it will be useful, but it *
* is provided "as is" and without any express or implied warranties.   *
* For more details see the full text of the license in the file        *
* LICENSE or in <http://www.gnu.org/licenses/>.                        *
***********************************************************************/
#ifndef _SEWINTS_
 (file)  ONEREL        "$WorkDir/$Project."OneRel          rw*
 (file)  BASINT        "$WorkDir/$Project."BasInt          rw
 (file)  SYMINFO       "$WorkDir/$Project."SymInfo         rw
 (file)  TEMP01        "$WorkDir/"purge.temp01             rw*p
 (file)  AMFI_INP      "$WorkDir/"purge.AMFI_INP           rw
 (file)  AMFI_INT      "$WorkDir/"purge.AMFI_INT           rw
#define _SEWINTS_
#endif

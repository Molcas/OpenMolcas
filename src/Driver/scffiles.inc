/***********************************************************************
* This file is part of OpenMolcas.                                     *
*                                                                      *
* OpenMolcas is free software; you can redistribute it and/or modify   *
* it under the terms of the GNU Lesser General Public License, v. 2.1. *
* OpenMolcas is distributed in the hope that it will be useful, but it *
* is provided "as is" and without any express or implied warranties.   *
* For more details see the full text of the license in the file        *
* LICENSE or in <http://www.gnu.org/licenses/>.                        *
***********************************************************************/
#ifndef _SCFFILES_
 (file)  DVXCDR   "$WorkDir/$Project."DVXCDR      rw
 (file)  DNSMAT   "$WorkDir/$Project."DNSMAT      rw
 (file)  TWOHAM   "$WorkDir/$Project."TWOHAM      rw
 (file)  ONEHAM   "$WorkDir/$Project."ONEHAM      rw
 (file)  GRADIENT "$WorkDir/$Project."GRADIENT    rw
 (file)  SOXVEC   "$WorkDir/$Project."SOXVEC      rw
 (file)  SOYVEC   "$WorkDir/$Project."SOYVEC      rw
 (file)  SODELTA  "$WorkDir/$Project."SODELTA     rw
 (file)  SODGRAD  "$WorkDir/$Project."SODGRAD     rw
 (file)  SMDINT   "$WorkDir/"purge.SmdInt         rw*p
 (file)  SODELTA  "$WorkDir/$Project."SODELTA     rw
 (file)  SODGRAD  "$WorkDir/$Project."SODGRAD     rw
#define _SCFFILES_
#endif

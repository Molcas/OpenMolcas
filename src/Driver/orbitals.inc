/***********************************************************************
* This file is part of OpenMolcas.                                     *
*                                                                      *
* OpenMolcas is free software; you can redistribute it and/or modify   *
* it under the terms of the GNU Lesser General Public License, v. 2.1. *
* OpenMolcas is distributed in the hope that it will be useful, but it *
* is provided "as is" and without any express or implied warranties.   *
* For more details see the full text of the license in the file        *
* LICENSE or in <http://www.gnu.org/licenses/>.                        *
***********************************************************************/
#ifndef _ORBITALS_
 (file)  GSSORB  "$WorkDir/$Project$SubProject."GssOrb        rwst
 (file)  EXPORB  "$WorkDir/$Project$SubProject".ExpOrb        rws
 (file)  DESORB  "$WorkDir/$Project$SubProject".DeSymOrb      rws
 (file)  GVORB   "$WorkDir/$Project$SubProject."GvOrb         rwst
 (file)  SCFORB  "$WorkDir/$Project$SubProject."ScfOrb        rwst
 (file)  UHFORB  "$WorkDir/$Project$SubProject."UhfOrb        rwst
 (file)  UNAORB  "$WorkDir/$Project$SubProject."UnaOrb        rwst
 (file)  MP2ORB  "$WorkDir/$Project$SubProject."MP2Orb        rwst
 (file)  RASORB  "$WorkDir/$Project$SubProject."RasOrb        rw*st
 (file)  DYSORB  "$WorkDir/$Project$SubProject."DysOrb        rw*st
 (file)  PT2ORB  "$WorkDir/$Project$SubProject."Pt2Orb        rw*st
 (file)  CPFORB  "$WorkDir/$Project$SubProject."CpfOrb        rwst
 (file)  IPAORB  "$WorkDir/$Project$SubProject."IPAOrb        rwst
 (file)  DPAORB  "$WorkDir/$Project$SubProject."DPAOrb        rwst
 (file)  LOCORB  "$WorkDir/$Project$SubProject."LocOrb        rwst
 (file)  ORTHORB "$WorkDir/$Project$SubProject."OrthOrb       rwst
 (file)  CIORB01 "$WorkDir/$Project$SubProject."CiOrb         rwst
 (file)  LPRORB  "$WorkDir/$Project$SubProject."LprOrb        rws
 (file)  SPDORB  "$WorkDir/$Project$SubProject."SpdOrb        rws*t
 (file)  SIORB   "$WorkDir/$Project$SubProject."SiOrb         rw*st
 (file)  SSORB   "$WorkDir/$Project$SubProject."SsOrb         rw*st
 (file)  BIORB   "$WorkDir/$Project$SubProject."BiOrb         rw*st
 (file)  TMPORB  "$WorkDir/$Project$SubProject."purge.TmpOrb  rwp
 (file)  SONATTDENS "$WorkDir/$Project$SubProject."SOOrb      rw*st
 (file)  SONATSDENS "$WorkDir/$Project$SubProject."SOSOrb     rw*st
 (file)  SODISDENS  "$WorkDir/$Project$SubProject."SODSOrb    rw*st
 (file)  SODILDENS  "$WorkDir/$Project$SubProject."SODLOrb    rw*st
 (file)  NTORB  "$WorkDir/$Project$SubProject."NTOrb          rw*st

#define _ORBITALS_
#endif

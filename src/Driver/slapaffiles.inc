/***********************************************************************
* This file is part of OpenMolcas.                                     *
*                                                                      *
* OpenMolcas is free software; you can redistribute it and/or modify   *
* it under the terms of the GNU Lesser General Public License, v. 2.1. *
* OpenMolcas is distributed in the hope that it will be useful, but it *
* is provided "as is" and without any express or implied warranties.   *
* For more details see the full text of the license in the file        *
* LICENSE or in <http://www.gnu.org/licenses/>.                        *
***********************************************************************/
#ifndef _SLAPAFFILES_
 (file)  RUNFILE2      "$WorkDir/$Project."RunFile2              rw
 (file)  INTCOR        "$WorkDir/$Project."IntCor                rwp
 (file)  SPCIN1        "$WorkDir/$Project$SubProject."SpcIn1     rw
 (file)  SPCINX        "$WorkDir/$Project$SubProject."SpcInx     rw
 (file)  UDC           "$WorkDir/$Project$SubProject."Udc        rwp
 (file)  UDC.Gateway   "$WorkDir/$Project."Udc.gateway           rw
 (file)  UDC.Saddle    "$WorkDir/$Project."Udc.saddle            r
 (file)  UDCTMP        "$WorkDir/$Project$SubProject."UdcTmp     rwp
 (file)  TSC           "$WorkDir/$Project$SubProject."TSC        rwp
 (file)  dRdX          "$WorkDir/$Project$SubProject."drdx       rwp
 (file)  UDIC          "$WorkDir/$Project$SubProject."Udic       rw
 (file)  XYZ           "$WorkDir/$Project$SubProject."Opt.xyz    rws
 (file)  QMMMITXYZ     "$WorkDir/$Project$SubProject."qmmm.xyz   rwst.
 (file)  QMMMENDXYZ    "$WorkDir/$Project$SubProject."qmmm.xyz   rwst
#define _SLAPAFFILES_
#endif

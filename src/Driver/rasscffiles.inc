/***********************************************************************
* This file is part of OpenMolcas.                                     *
*                                                                      *
* OpenMolcas is free software; you can redistribute it and/or modify   *
* it under the terms of the GNU Lesser General Public License, v. 2.1. *
* OpenMolcas is distributed in the hope that it will be useful, but it *
* is provided "as is" and without any express or implied warranties.   *
* For more details see the full text of the license in the file        *
* LICENSE or in <http://www.gnu.org/licenses/>.                        *
***********************************************************************/
#ifndef _RASSCFFILES_
 (file)  TRAINT        "$WorkDir/"purge.traint               rwp
 (file)  TEMP01        "$WorkDir/"purge.tmp001               rwp
 (file)  TEMP02        "$WorkDir/"purge.tmp002               rwp
 (file)  CIDIA         "$WorkDir/"purge.cidia                rwpe
 (file)  LUCVECT       "$WorkDir/"purge.lucvect              rwpe
 (file)  HCFILE        "$WorkDir/"purge.hcfile               rwpe
 (file)  LUSC          "$WorkDir/"purge.lusc                 rw*pe
 (file)  CIITER        "$WorkDir/"CI_Iterations.txt          rw
 (file)  LUMOUT        "$WorkDir/"purge.lumout               rwp
 (file)  TMP0          "$WorkDir/"purge.temp00               rw*p
 (file)  MCPDFT        "$WorkDir/$Project$SubProject".McDens rw*st
 (file)  MCTRUD        "$WorkDir/$Project$SubProject".McTrue rw*st
#define _RASSCFFILES_
#endif

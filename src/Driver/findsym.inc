/***********************************************************************
* This file is part of OpenMolcas.                                     *
*                                                                      *
* OpenMolcas is free software; you can redistribute it and/or modify   *
* it under the terms of the GNU Lesser General Public License, v. 2.1. *
* OpenMolcas is distributed in the hope that it will be useful, but it *
* is provided "as is" and without any express or implied warranties.   *
* For more details see the full text of the license in the file        *
* LICENSE or in <http://www.gnu.org/licenses/>.                        *
***********************************************************************/
#ifdef _HAVE_EXTRA_
#ifndef _FINDSYM_
 (file)  FS.tmp        "$WorkDir/findsym.tmp"               rwp
 (file)  FS.inp        "$WorkDir/findsym.inp"               rw
 (file)  FS.out        "$WorkDir/findsym.out"               rw
 (file)  FS.std        "$WorkDir/findsym.std"               rw
#define _FINDSYM_
#endif
#endif
